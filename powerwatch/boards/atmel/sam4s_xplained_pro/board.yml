## powerwatch/boards/atmel/sam4s_xplained_pro/board.yml
```yaml
board:
  name: sam4s_xplained_pro
  full_name: SAM4S Xplained Pro
  vendor: atmel
  socs:
    - name: sam4s8b
```

## powerwatch/west.yml
```yaml
manifest:
  remotes:
    - name: zephyrproject-rtos
      url-base: https://github.com/zephyrproject-rtos

  projects:
    - name: zephyr
      remote: zephyrproject-rtos
      revision: v4.4.1
      import:
        name-allowlist:
          - cmsis # CMSIS 5 (ARM core support)
          - cmsis_6 # CMSIS 6 (provides cmsis_core.h for Cortex-M)
          - hal_atmel # SAM4S register/HAL support

  self:
    path: powerwatch
```
